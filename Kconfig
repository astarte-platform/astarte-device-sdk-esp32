## Kconfig
```kconfig
#
# This file is part of Astarte.
#
# Copyright 2018-2023 SECO Mind Srl
#
# Licensed under the Apache License, Version 2.0 (the "License");
# you may not use this file except in compliance with the License.
# You may obtain a copy of the License at
#
#    http://www.apache.org/licenses/LICENSE-2.0
#
# Unless required by applicable law or agreed to in writing, software
# distributed under the License is distributed on an "AS IS" BASIS,
# WITHOUT WARRANTIES OR CONDITIONS OF ANY KIND, either express or implied.
# See the License for the specific language governing permissions and
# limitations under the License.
#
# SPDX-License-Identifier: LGPL-2.1-or-later OR Apache-2.0
#

menu "Astarte SDK"

config ASTARTE_DEVICE_SDK_REALM_NAME
	string "Realm name"
	help
	  Astarte realm name where to connect the device.

config ASTARTE_DEVICE_SDK_HOSTNAME
	string "Hostname for the Astarte APIs"
	help
	  This hostname will be solved using a DNS to the IP address of the Astarte instance.

config ASTARTE_DEVICE_SDK_PAIRING_JWT
	string "JWT to be used when registering a new device"
	help
	  This option should be set to a valid value when using the pairing API to register a new
	  device.

config ASTARTE_DEVICE_SDK_NVS
	bool "Permanent storage for Astarte device"
	default y
	help
	  This option enables the permanent storage in for the Astarte device.
	  It requires at least an NVS partition to be present on the device.

config ASTARTE_DEVICE_SDK_NVS_PARTITION_LABEL
    string "NVS partition label to use for caching properties"
    default "nvs"
    depends on ASTARTE_DEVICE_SDK_NVS
    help
        Use this option to specify a custom NVS partition for caching the received properties.

config ASTARTE_DEVICE_SDK_RECONNECTION_ASTARTE_BACKOFF_INITIAL_MS
	int "Astarte reconnection backoff initial delay (ms)"
	default 1000
	help
	  This configuration setting will define an initial delay for the reconnection backoff strategy
	  to Astarte. This backoff strategy will be used when there is no MQTT error but the handshake
	  with Astarte has failed.

config ASTARTE_DEVICE_SDK_RECONNECTION_ASTARTE_BACKOFF_MAX_MS
	int "Astarte reconnection backoff maximum delay (ms)"
	default 60000
	help
	  This configuration setting will define the maximum delay for the reconnection backoff
	  strategy to Astarte. This backoff strategy will be used when there is no MQTT error but the
	  handshake with Astarte has failed.

menu "Development options"

config ASTARTE_DEVICE_SDK_DEVELOP_USE_NON_TLS_HTTP
	bool "Disable TLS for all HTTP requests"
	default false
	depends on CONFIG_ESP_TLS_INSECURE
	depends on CONFIG_ESP_TLS_SKIP_SERVER_CERT_VERIFY
	help
	  Enable this option to connect to a local Astarte instance.
	  With this option enabled all HTTP(s) operations will be performed over an unsecure channel,
	  without TLS and using port 80 instead of 443.

	  Should be used only for development purposes as it's highly unsafe.

config ASTARTE_DEVICE_SDK_DEVELOP_USE_NON_TLS_MQTT
	bool "Disable TLS for all MQTT connections"
	default false
	depends on CONFIG_ESP_TLS_INSECURE
	depends on CONFIG_ESP_TLS_SKIP_SERVER_CERT_VERIFY
	help
	  Enable this option to connect to a local Astarte instance.
	  With this option enabled all MQTT(s) operations will still be perfomed using mutual TLS
	  authentication. However, any error related the server certificate will be ignored.

	  Should be used only for development purposes as it's highly unsafe.

endmenu

menu "Advanced options"

config ASTARTE_DEVICE_SDK_ADVANCED_CLIENT_CRT_BUFFER_SIZE
	int "Buffer size for client TLS certificate"
	default 2048
	help
	  Use this option to increase/decrease the buffer size where the TLS client certificate is
	  stored.

endmenu

endmenu
```

## end_to_end_tests/app/main/Kconfig.projbuild
```kconfig
# (C) Copyright 2025, SECO Mind Srl
#
# SPDX-License-Identifier: Apache-2.0

menu "Astarte application sample"

config DEVICE_ID
    string "Device hardware ID"
    default ""
    help
        Device ID to be used to connect to Astarte.

config CREDENTIAL_SECRET
    string "Credential secret"
    default ""
    help
        The credential secret to be used to connect to Astarte.

config DEVICE_POLL_PERIOD_MS
    int "Device thread polling period (ms)"
    default 100
    help
        Use this setting to change the polling period for the Astarte device.

endmenu
```

## end_to_end_tests/app/sdkconfig.defaults
```kconfig
# (C) Copyright 2025, SECO Mind Srl
#
# SPDX-License-Identifier: Apache-2.0

# Configuration to use our custom partition table
CONFIG_PARTITION_TABLE_CUSTOM=y
CONFIG_PARTITION_TABLE_CUSTOM_FILENAME="partition_table.csv"
CONFIG_PARTITION_TABLE_FILENAME="partition_table.csv"
CONFIG_ESPTOOLPY_FLASHSIZE_4MB=y

# Astarte device configuration
CONFIG_ASTARTE_DEVICE_SDK_NVS=y
CONFIG_ASTARTE_DEVICE_SDK_NVS_PARTITION_LABEL="astarte"
```

## examples/astarte_app/main/Kconfig.projbuild
```kconfig
# (C) Copyright 2025, SECO Mind Srl
#
# SPDX-License-Identifier: Apache-2.0

menu "Astarte application sample"

config WIFI_SSID
    string "WiFi SSID"
    default "myssid"
    help
        SSID (network name) for the example to connect to.

config WIFI_PASSWORD
    string "WiFi Password"
    default "mypassword"
    help
        WiFi password (WPA or WPA2) for the example to use.

config DEVICE_ID
    string "Device hardware ID"
    default ""
    help
        Device ID to be used to connect to Astarte.

config CREDENTIAL_SECRET
    string "Credential secret"
    default ""
    depends on !DEVICE_REGISTRATION
    help
        The credential secret to be used to connect to Astarte.

config DEVICE_POLL_PERIOD_MS
    int "Device thread polling period (ms)"
    default 100
    help
        Use this setting to change the polling period for the Astarte device.

config DEVICE_OPERATIONAL_TIMEOUT
    int "Operational time in sedonds for which the device will stay connected to astarte"
    default 60
    depends on !DEVICE_INDIVIDUAL_TRANSMISSION
    depends on !DEVICE_OBJECT_TRANSMISSION
    depends on !DEVICE_PROPERTY_SET_TRANSMISSION
    depends on !DEVICE_PROPERTY_UNSET_TRANSMISSION
    help
        The device will stay connected to astarte for the specified number of seconds,
        after this time the device will be disconnected and the sample will end.
        This option gets automatically enabled when no transmission is configured to
        allow the device to wait for messages from the server.

menu "Registration"

config DEVICE_REGISTRATION
    bool "Enable device registration in the sample"
    default n
    help
        Use this setting to enable the registration of the device given a pairing jwt.
        The registration will use the defined jwt in ASTARTE_DEVICE_SDK_PAIRING_JWT.

endmenu

menu "Individual transmission"

config DEVICE_INDIVIDUAL_TRANSMISSION
    bool "Enable sample transmission of astarte individuals"
    default y
    help
        Use this setting to enable the transmission of astarte inviduals in the sample.

config DEVICE_INDIVIDUAL_TRANSMISSION_DELAY_SECONDS
    int "Device transmission delay (s)"
    default 10
    depends on DEVICE_INDIVIDUAL_TRANSMISSION
    help
        Use this setting to change how long to wait before sending individuals.
        This delay starts after the device connects to astarte: a delay of 0 means that all
        individuals will be sent just after a connection event.

endmenu

menu "Object transmission"

config DEVICE_OBJECT_TRANSMISSION
    bool "Enable sample transmission of astarte objects"
    default y
    help
        Use this setting to enable the transmission of astarte objects in the sample.

config DEVICE_OBJECT_TRANSMISSION_DELAY_SECONDS
    int "Device transmission delay (s)"
    default 10
    depends on DEVICE_OBJECT_TRANSMISSION
    help
        Use this setting to change how long to wait before sending objects.
        This delay starts after all individuals got sent: a delay of 0 means that all objects
        will be sent just after the individual got sent.

endmenu

menu "Property transmission"

config DEVICE_PROPERTY_SET_TRANSMISSION
    bool "Enable sample transmission of astarte properties set"
    default y
    help
        Use this setting to enable the transmission of astarte properties set in the sample.

config DEVICE_PROPERTY_SET_TRANSMISSION_DELAY_SECONDS
    int "Device transmission delay (s)"
    default 10
    depends on DEVICE_PROPERTY_SET_TRANSMISSION
    help
        Use this setting to change how long to wait before setting properties.
        This delay starts after all objects got sent: a delay of 0 means that all properties
        will be set just after the object got sent.

config DEVICE_PROPERTY_UNSET_TRANSMISSION
    bool "Enable sample transmission of astarte properties unset"
    default y
    help
        Use this setting to enable the transmission of astarte properties unset in the sample.

config DEVICE_PROPERTY_UNSET_TRANSMISSION_DELAY_SECONDS
    int "Send property unset transmission delay (s)"
    default 10
    depends on DEVICE_PROPERTY_UNSET_TRANSMISSION
    help
        Use this setting to change how long to wait before sending properties unsets.
        This delay starts after all properties got set: a delay of 0 means that all properties
        will be unset just after they got set.

endmenu

endmenu
```

## samples/astarte_app/sdkconfig.defaults
```kconfig
# (C) Copyright 2025, SECO Mind Srl
#
# SPDX-License-Identifier: Apache-2.0

# Configuration to use our custom partition table
CONFIG_PARTITION_TABLE_CUSTOM=y
CONFIG_PARTITION_TABLE_CUSTOM_FILENAME="partition_table.csv"
CONFIG_PARTITION_TABLE_CUSTOM_APP_BIN_OFFSET=0x10000
CONFIG_PARTITION_TABLE_FILENAME="partition_table.csv"
CONFIG_APP_OFFSET=0x10000
CONFIG_ESPTOOLPY_FLASHSIZE_4MB=y

# Astarte device configuration
CONFIG_ASTARTE_DEVICE_SDK_HOSTNAME="......................"
CONFIG_ASTARTE_DEVICE_SDK_REALM_NAME="......................"
# Enable for registration through JWT
# CONFIG_ASTARTE_DEVICE_SDK_PAIRING_JWT="."
CONFIG_ASTARTE_DEVICE_SDK_NVS=y
CONFIG_ASTARTE_DEVICE_SDK_NVS_PARTITION_LABEL="astarte"

# Astarte sample configuration
CONFIG_WIFI_SSID="......................"
CONFIG_WIFI_PASSWORD="......................"
CONFIG_DEVICE_ID="......................"
# Enable for manual registration
# CONFIG_CREDENTIAL_SECRET="."
CONFIG_DEVICE_REGISTRATION=n
CONFIG_DEVICE_INDIVIDUAL_TRANSMISSION=n
CONFIG_DEVICE_OBJECT_TRANSMISSION=n
CONFIG_DEVICE_PROPERTY_SET_TRANSMISSION=n
CONFIG_DEVICE_PROPERTY_UNSET_TRANSMISSION=n
```
